## main/Kconfig.projbuild
```kconfig
menu "DSC KeyBus Setup"

config KEYBUS_MSG_SIZE
    int "Max KeyBus MSG Size in bytes"
    default 128
    help
        Max KeyBus message size in bytes

choice KEYBUS_INTERFACE_IMPLEMENTATION
  prompt "KeyBus Interface Implementation"
  default KEYBUS_IMPL_TIMERS
  help
    Choose KeyBus protocol implementation

config KEYBUS_IMPL_TIMERS
  bool "Use Timers"
config KEYBUS_IMPL_IRQ
  bool "Only use interrupts on clk line"
endchoice


config KEYBUS_WAIT_US
  int "KeyBus wait microseconds for end message"
  default 2000
  help
    Microseconds elapsed since last bit received to determine new message


endmenu


menu "ESP32 DSC WiFi Setup"

choice ESP_WIFI_MODE
    prompt "AP or STA"
    default ESP_WIFI_IS_STATION
    help
        Whether the esp32 is softAP or station.

config ESP_WIFI_IS_SOFTAP
    bool "SoftAP"
config ESP_WIFI_IS_STATION
    bool "Station"
endchoice

config ESP_WIFI_MODE_AP
    bool
    default y if ESP_WIFI_IS_SOFTAP
    default n if ESP_WIFI_IS_STATION

config ESP_WIFI_SSID
    string "WiFi SSID"
    default "myssid"
    help
	SSID (network name) for the example to connect to.

config ESP_WIFI_PASSWORD
    string "WiFi Password"
    default "mypassword"
    help
	WiFi password (WPA or WPA2) for the example to use.

config MAX_STA_CONN
    int "Max STA conn"
    default 4
    help
	Max number of the STA connects to AP.
endmenu
```
